## meta-senic/conf/distro/senic.conf
```bitbake
DISTRO_NAME = "senic"

IMAGE_LINGUAS = "en-us"

DISTRO_FEATURES = "${DISTRO_FEATURES_DEFAULT} ${DISTRO_FEATURES_LIBC} usb bluetooth wifi"
DISTRO_TYPE ?= "release"
```

## meta-senic/conf/local.conf.sample
```bitbake
MACHINE = "senic-hub"
DISTRO = "senic-dev"
# actual version is set during build process, this is just a placeholder
DISTRO_VERSION = "XXX"
TARGET_VENDOR = "-senic"
MAINTAINER = "Senic GmbH <hi@senic.com>"

# shared locations
DL_DIR ?= "/var/senic/shared/downloads"
SSTATE_DIR ?= "/var/senic/shared/sstate-cache"

PACKAGE_CLASSES ?= "package_ipk"

#  "debug-tweaks"   - make an image suitable for development
#                     e.g. ssh root access has a blank password
# There are other application targets that can be used here too, see
# meta/classes/image.bbclass and meta/classes/core-image.bbclass for more details.
# We default to enabling the debugging tweaks.
# EXTRA_IMAGE_FEATURES ?= "debug-tweaks"

USER_CLASSES ?= "buildstats image-mklibs image-prelink"

# make compatible with running builds inside screen
OE_TERMINAL = "screen"
# By default disable interactive patch resolution (tasks will just fail instead):
PATCHRESOLVE = "noop"

BB_DISKMON_DIRS = "\
    STOPTASKS,${TMPDIR},1G,100K \
    STOPTASKS,${DL_DIR},1G,100K \
    STOPTASKS,${SSTATE_DIR},1G,100K \
    STOPTASKS,/tmp,100M,100K \
    ABORT,${TMPDIR},100M,1K \
    ABORT,${DL_DIR},100M,1K \
    ABORT,${SSTATE_DIR},100M,1K \
    ABORT,/tmp,10M,1K"
PACKAGECONFIG_append_pn-qemu-native = " sdl"
PACKAGECONFIG_append_pn-nativesdk-qemu = " sdl"

# CONF_VERSION is increased each time build/conf/ changes incompatibly and is used to
# track the version of this file when it was generated. This can safely be ignored if
# this doesn't mean anything to you.
CONF_VERSION = "1"

# For Mender integration
#
MENDER_ARTIFACT_NAME = "${DISTRO_VERSION}"
# we exceed the default size, so we must set it explicitly
MENDER_STORAGE_TOTAL_SIZE_MB = "1036"
# squeeze some more size by reducing the data partition
MENDER_DATA_PART_SIZE_MB = "10"
MENDER_DATA_PART_DIR_append = " ${DEPLOY_DIR_IMAGE}/hub-data"
MENDER_UPDATE_POLL_INTERVAL_SECONDS = "60"
MENDER_INVENTORY_POLL_INTERVAL_SECONDS = "60"

# hub specific variables
#

SNC_BUILD_USER = "root"
SNC_RUNTIME_USER = "senic"
SNC_LOCALE = "en_US.UTF-8"

SNC_BACKEND_DEPLOY_LOCATION = "/srv/senic_hub"
SNC_BACKEND_DATA_LOCATION = "/data/senic-hub"
SNC_HASS_DATA_LOCATION = "/data/senic-hub"
SNC_DEVPI_BASE_URL = "https://pypi.senic.com/"
SNC_DEVPI_INDEX = "root/pypi"

# Set up our own ntp servers for production!
# Use this only for beta testing.
SNC_NTP_HOST = "pool.ntp.org"

# Sentry endpoint for exception logging
# TODO: provide a way for the user to opt-in for the production release!
SNC_SENTRY_DSN = "https://2601699ddeb64448bd4499a57a8887b8:9db76c84b3ca415290bf952197ab9739@sentry.io/179864"
```

## meta-senic/conf/machine/senic-hub.conf
```bitbake
#@TYPE: Machine
#@NAME: senic-hub
#@DESCRIPTION: Machine configuration for Senic Hub that is based on NanoPi NEO v1.3 + Baseboard

include conf/machine/include/soc-family.inc
require conf/machine/include/tune-cortexa7.inc

SOC_FAMILY = "sun8i"
DEFAULTTUNE = "cortexa7hf-neon-vfpv4"

# Kernel
PREFERRED_PROVIDER_virtual/kernel ?= "linux"
KERNEL_IMAGETYPE = "zImage"
KERNEL_DEVICETREE = "sun8i-h3-senic-hub.dtb"
SERIAL_CONSOLE = "115200 ttyS0"

# Install kernel and devicetree
RDEPENDS_kernel-base += "kernel-image kernel-devicetree"

# Bootloader
PREFERRED_PROVIDER_virtual/bootloader = "u-boot-senic"
UBOOT_ARCH = "arm"
UBOOT_MACHINE = "senic_hub_defconfig"

# To build the u-boot image
EXTRA_IMAGEDEPENDS += "virtual/bootloader"

# Add Bluetooth as machine features as USB dongles will be used
MACHINE_FEATURES += "bluetooth wifi"

# the rtc feature is incompatible with our packagroup constellation, so we must disable it
# (also our board doesn't have a realtime clock anyway...)
MACHINE_FEATURES_BACKFILL_CONSIDERED = "rtc"

# To create a wic image to deploy it on a SD-card
IMAGE_FSTYPES = "ext4"
EXTRA_IMAGEDEPENDS += "dosfstools-native mtools-native"
MACHINE_EXTRA_RDEPENDS += "kernel-modules"
```

## meta-senic/scripts/lib/wic/canned-wks/senic-sdcard.wks
```
# short-description: Create SD card image with a boot partition
# long-description: Creates a partitioned SD card image. Boot files
# are located in the first vfat partition.
part u-boot --source rawcopy --sourceparams="file=u-boot-sunxi-with-spl.bin" --ondisk mmcblk0 --no-table --align 8
part /boot --source bootimg-partition --ondisk mmcblk0 --fstype=vfat --label boot --active --align 4096 --size 16
part / --source rootfs --ondisk mmcblk0 --fstype=ext4 --label root --align 4 --size 512
```
